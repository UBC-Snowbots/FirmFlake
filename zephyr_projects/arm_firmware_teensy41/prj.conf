## prj.conf
```kconfig
CONFIG_STDOUT_CONSOLE=y
CONFIG_USB_DEVICE_STACK=y
CONFIG_USB_DEVICE_PRODUCT="UBC ROVER Arm"
CONFIG_USB_DEVICE_PID=0x0001
CONFIG_LOG=y
CONFIG_USB_DRIVER_LOG_LEVEL_ERR=y
CONFIG_USB_DEVICE_LOG_LEVEL_ERR=y
CONFIG_SERIAL=y
CONFIG_UART_INTERRUPT_DRIVEN=y
CONFIG_UART_LINE_CTRL=y
CONFIG_USB_DEVICE_INITIALIZE_AT_BOOT=n
CONFIG_STATIC_INIT_GNU=y
CONFIG_GPIO=y
CONFIG_CPP=y
CONFIG_REQUIRES_FULL_LIBCPP=y
#old:
# CONFIG_NEWLIB_LIBC=y

# new:
CONFIG_PICOLIBC=y
CONFIG_PICOLIBC_IO_FLOAT=y
```

## include/Axis.h
```c
#pragma once
#include <armFirmware.h>
// #define INIT_AXIS(i) Axis(stepPins[i], dirPins[i], encPinA[i], encPinB[i], ppr[i], red[i])

//if an axis is within this many steps to its max/min
#define POSITION_STEP_LIMIT_THRESHOLD 50

struct Axis {

    //variables don't get properly set here, even if "int foo = 1000;" foo will still equal 0. initilize in the main function of main.cpp
   // Axis(int dirPin, int stepPin, int encPinA, int encPinB, long ppr, float reduction);
    //setup pins
    int index;
    int LIMIT_PIN[2];
    int DIR_PIN[2];
    int STEP_PIN[2];
    int ENC_PIN_A;
    int ENC_PIN_B;
    //motor gear reduction and driver PPR (make sure to factor in microstep settings)
    int PPR;
    float REDUCTION;
    bool pulse_state;
    bool moving;
    
    //units here are usec per step
    int max_speed;
    int home_speed;
    volatile int current_speed = 10000;
    volatile int target_speed = 10000;
    int max_start_speed = 20000;
    int zero_speed = 10000; //limits minimum speed to a feasible start speed


    int home_accel = 0;
    int start_accel = 250; 
    int accel_slope = 10; //should stay at 1 for maximum smoothness
    int current_accel = 20000;

    float target_velocity;
    float current_velocity;
    float max_velocity;
    float home_velocity;

    int macrostep;

    bool dir;
    bool last_dir = 0;
    //bool dir_signal;
    int home_dir;
    int home_dir_vel;
    bool homing;
    bool homed = false;
    int preset_step_pos[1];

    int max_step_pos;
    int min_step_pos = 20 + POSITION_STEP_LIMIT_THRESHOLD;

    volatile int steps_remaining;
    volatile int step_pos = 0; // not from encoders
    volatile int step_des_pos;

    int decel_min_steps;

    volatile float des_angle_pos = 0.0;
    volatile float angle_pos = 0.0;
    //float max_angle_
    
    struct k_timer stepper_timer;
    struct k_timer accel_timer;
    struct gpio_callback limit_switch_cb_data;

//   // Code to configure pins
//   const struct device *stepdev;
//   const struct device *dirdev;
//   const struct device *limdev;
//   static struct gpio_callback limit_switch_cb_data;


    void attach();
    void readEncoder();
    void updateAngles();

    //void step(int steps);
    void home();

 
    
};
```

## include/armFirmware.h
```c
/*
Created By: Rowan Z
Created On: August 17, 2023
Updated On: 
Description: Header file for firmware for driving a 6 axis arm via ROS on a teensy 4.1 MCU
*/

//TODO, 
/* more tags throughout code in this zephyr project

crashes with more than 3 axis -- wrong gpio, pin 11 was messed
weird shit in the buffer, but will just sanitize -- not processing tx buffer data properly



this is not easy

*/
#pragma once
#include <stdlib.h>
#include <stdio.h>

#include <zephyr/kernel.h>
#include <zephyr/device.h>
#include <zephyr/drivers/uart.h>
#include <zephyr/sys/ring_buffer.h>
#include <zephyr/logging/log.h>


//usb (needed for uart)
#include <zephyr/usb/usb_device.h>
#include <zephyr/usb/usbd.h>

#include <zephyr/drivers/gpio.h>

#include <Axis.h>

#include <string>

// #define UART_DEVICE_NODE DT_CHOSEN(zephyr_shell_uart)
//#define UART_DEVICE DT_NODELABEL(lpuart4) 
// #define UART_DEV        DT_NODELABEL(lpuart4)
#define MSG_SIZE 32

#define DEBUG_MSGS false

// general parameters
#define NUM_AXES 7
#define ON 0
#define OFF 1
#define SW_ON 0
#define SW_OFF 1
#define FWD 1
#define REV 0

#define RING_BUF_SIZE 2048
#define RX_BUF_SIZE 128
#define TX_BUF_SIZE 128

#define ARM_DEG_RESOLUTION 0.01
#define ARM_DEG_VELOCITY_RESOLUTION 0.05
#define EE_INDEX 6

#define HOME 1
#define ABSOLUTE_TARGET_POSITION 2
#define INCREMENTAL_TARGET_POSITION 3
#define TARGET_VELOCITY_ID 4 //sets the target velocity, but doesnt command arm, will only move if there are steps_remaining
#define TEST_LIMITS 5
#define ABSOLUTE_TARGET_VELOCITY_ID 6 //sets target velocity, and commands arm to move at that velocity
#define HELP_CMDTYPE 7


#define POSITION_CONTROL 1 
#define VELOCITY_CONTROL 2 
#define PRO_MODE false //removes accelleration limits. This is dangerous, but gives the operator full control over when the arm stops


#define NUM_PRESET_POSITIONS 1
#define DEFAULT_POSITION 0

#define POSITION_PING_MS_INTERVAL 10 // 50ms is 20 hz // 20ms is 50hz // 10ms is 100hz 

#define SPEED_PING_MS_INTERVAL 150 // 50ms is 20 hz


#define ARM_COMM_RATE 100 //Hz, only here for refrence

//comm characters
#define HOME_CHAR 'h'
#define ANGLE_CALLBACK_CHAR 'A'
#define HELP_CHAR '?'

#define ACCEL_CURVE 1





//weird pin mappings
//all the usefull documentation I could find: https://docs.zephyrproject.org/latest/boards/arm/teensy4/doc/index.html 
// https://docs.zephyrproject.org/latest/boards/pjrc/teensy4/doc/index.html

// Motor pins     
// inline int stepPins[6] =   {6, 8, 2, 10, 12, 25}; 
// inline int dirPins[6] =    {5, 7, 1, 9, 11, 24}; 

//To GPIO devs                  //not working: 3 //working one dir: 1   // working: 2, 4, 5, 6 
inline int stepGPIO_PIN[NUM_AXES][2] =   {{2,10}, {2,16}, {1,3}, {2,0}, {2,1}, {1,13}, {2,18}}; 
inline int dirGPIO_PIN[NUM_AXES][2] =    {{1,30}, {2,17}, {1,2}, {2,11}, {2,2}, {1,12}, {2,19}}; 
// inline int stepGPIO_PIN[NUM_AXES][2] =   {{2,10}, {2,16}, {1,3}, {2,0}, {2,1}, {2,18}, {1, 13}}; 
// inline int dirGPIO_PIN[NUM_AXES][2] =    {{1,30}, {2,17}, {1,2}, {2,11}, {2,2}, {2,19}, {1, 12}}; 
inline int arpo = 0;

// Encoder pins
// inline int encPinA[6] = {17, 38, 40, 36, 13, 15};
// inline int encPinB[6] = {16, 37, 39, 35, 41, 14};

// limit switch pins
// inline int limPins[6] = {18, 19, 20, 21, 22, 23};
inline int limGPIO_PIN[NUM_AXES][2] = {{1,17}, {1,16}, {1,26}, {1,27}, {1,24}, {1,25}, {1, 16}}; // EE just reuses a2. EE doesn't home via a switch, so its just a placeholder.
// pulses per revolution for motors
inline int ppr[NUM_AXES] = {400, 400, 400, 400, 400, 400, 400};

// Gear Reductions
// inline float red[6] = {50.0, 160.0, 92.3077, 43.936, 57.0, 5.18}; 
inline float red[NUM_AXES] = {50.0, 160.0, 92.3077, 345.09973333333335, 57.0, 170.00, 100.0}; //? Double check with arm 
// inline float red[6] = {50.0, 160.0, 92.3077, 43.936, 57.0, 20.00}; //? Double check with arm -> August 11th
//?A6 10:17 for belts -> 170 to one - Old?

// A4 with new motor and belt...
// MOTOR: 100:1, apparently 99.548:1
// Pinion Teeth: 15
// Big gear: 52 (counted 13 then x4)
// Total: 99.548/1 * 52/15 = 345.09973333333335
// Changed from 250 , which was obbsly off


//from old driver
// // Motor pins      
// int stepPins[6] =   {6, 8, 2, 10, 12, 25}; 
// int dirPins[6] =    {5, 7, 1, 9, 11, 24}; 

// // Encoder pins
// int encPinA[6] = {17, 38, 40, 36, 13, 15};
// int encPinB[6] = {16, 37, 39, 35, 41, 14};

// // limit switch pins
// int limPins[6] = {18, 19, 20, 21, 23, 22};

// // pulses per revolution for motors
// long ppr[6] = {400, 400, 400, 400, 400, 400};

// // Gear Reductions
// float red[6] = {50.0, 160.0, 92.3077, 43.936, 57.0, 5.18};

// End effector variables
const int closePos = 0; 
const int openPos = 9000; //TODO: needs to be set with proper step value for gear redcution and ppr
const int EEstepPin = 4;
const int EEdirPin = 3;
const int speedEE = 1000;
const int accEE = 1000;
const int MOTOR_DIR_EE = -1;
const int forcePin = 12;


inline bool arm_homing = false;
inline bool arm_inited = false;


// Encoder Variables
inline int curEncSteps[NUM_AXES], cmdEncSteps[NUM_AXES];
const int pprEnc = 512;
// const float ENC_MULT[] = {5.12, 5.12, 5.12, 5.12, 5.12, 5.12};
inline float ENC_STEPS_PER_DEG[NUM_AXES];

inline int control_mode = VELOCITY_CONTROL;


//this creates the device for gpio pins
inline const struct device *gpio1_dev;
inline const struct device *gpio2_dev;
inline const struct device *gpio3_dev;
inline const struct device *gpio4_dev;


inline struct ring_buf ringbuf;


inline const struct device *dev;
//inline char tx_msg[TX_BUF_SIZE];

void sendMsg(const char *tx_msg);
void sendBytes(const uint8_t *data, size_t len);
void copyField(char *dst, size_t dst_size, const char *start, const char *end);

//timer callback to handle step signals
void stepper_timer_callback(struct k_timer *timer_id);

void home_timer_callback(struct k_timer *timer_id);
void accelTimer_callback(struct k_timer *timer_id);


void limit_switch_callback(const struct device *dev, struct gpio_callback *cb, uint32_t pins);

void parseCmd(uint8_t cmd[RX_BUF_SIZE]);
void parseAbsoluteTargetPositionCmd(uint8_t cmd[RX_BUF_SIZE]);
void parseIncrementalTargetPositionCmd(uint8_t cmd[RX_BUF_SIZE]);
void parseHomeCmd(uint8_t cmd[RX_BUF_SIZE]);
void parseHelpCmd(uint8_t cmd[RX_BUF_SIZE]);
void parseSettingCmd(uint8_t cmd[RX_BUF_SIZE]);
void parseAbsoluteTargetVelocityCmd(uint8_t cmd[RX_BUF_SIZE]);

void testLimits();


void initilizeAxis(struct InstAxis *instance);
void stepAxis(int axis);
void stepAll_timer_callback(struct k_timer *timer_id);
void pingStepPosition_timer_callback(struct k_timer *timer_id);
void pingAnglePosition_timer_callback(struct k_timer *timer_id);

int angleToSteps(float angle, int i);
float stepsToAngle(int steps, int i);
int degPerSecToUsecPerStep(float angle, int i);
int degPerSecToMsecPerStep(float angle, int i);
float usecPerStepToDegPerSec(int steps, int i);


void updateAngles();

//void stepTo(int pos);
void homeAllAxes();
//inline bool homed[NUM_AXES] = {0};

void goto_preset(int position);

int pos_or_negative_float(float val);


void set_gpio(int dev, int pin, int value);
int get_gpio(int dev, int pin);
```

## src/Axis.cpp
```c
#include "Axis.h"

//struct k_timer stepper_timer;

// Axis::Axis(int dirPin, int stepPin, int encPinA, int encPinB, long ppr, float reduction)
//   : DIR_PIN(dirPin), STEP_PIN(stepPin), ENC_PIN_A(encPinA), ENC_PIN_B(encPinB), PPR(ppr), REDUCTION(reduction) {}
  // Code to configure pins
  const struct device *stepdev;
  const struct device *dirdev;
  const struct device *limdev;


void Axis::attach() {



	switch (STEP_PIN[0])
	{
	case 1:
		stepdev = gpio1_dev;
		break;
	
	case 2:
		stepdev = gpio2_dev;

		break;
	case 4:
		stepdev = gpio2_dev;
		break;
	default:
		break;
	}

  switch (DIR_PIN[0])
	{
	case 1:
		dirdev = gpio1_dev;
		break;
	
	case 2:
		dirdev = gpio2_dev;
		break;
	case 4:
		dirdev = gpio2_dev;
		break;
	default:
		break;
	}

  switch (LIMIT_PIN[0])
	{
	case 1:
		limdev = gpio1_dev;
		break;
	
	case 2:
		limdev = gpio2_dev;

		break;
	case 4:
		limdev = gpio2_dev;
		break;
	default:
		break;
	}

    int zoo;
    zoo = gpio_pin_configure(stepdev, STEP_PIN[1], GPIO_OUTPUT);
    zoo = zoo ? zoo : gpio_pin_configure(dirdev, DIR_PIN[1], GPIO_OUTPUT);
    zoo = zoo ? zoo : gpio_pin_configure(limdev, LIMIT_PIN[1], GPIO_INPUT | GPIO_PULL_UP); // zooooo!
	// gpio_init_callback(&limit_switch_cb_data, limit_switch_callback, BIT(LIMIT_PIN[1]));
	// gpio_add_callback(limdev, &limit_switch_cb_data);
	// gpio_pin_interrupt_configure(limdev, LIMIT_PIN[1], GPIO_INT_EDGE_FALLING);



    //gpio_pin_configure(gpio_dev, axes[i].STEP_PIN, GPIO_OUTPUT);
	  // gpio_pin_configure(gpio_dev, axes[i].DIR_PIN, GPIO_OUTPUT);

  //  // err = err ? err : gpio_pin_configure(g)
}



void Axis::readEncoder() {
  // Code to read the encoder
}



void Axis::home() {
  // Code to home the axis
}
```
