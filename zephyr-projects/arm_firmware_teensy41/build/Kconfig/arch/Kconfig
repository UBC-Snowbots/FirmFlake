## zephyr-projects/arm_firmware_teensy41/build/Kconfig/arch/Kconfig
```kconfig
# Load Zephyr Arch Kconfig descriptions.
osource "/home/rowan/zephyrproject/zephyr/arch/x86/Kconfig"
osource "/home/rowan/zephyrproject/zephyr/arch/xtensa/Kconfig"
osource "/home/rowan/zephyrproject/zephyr/arch/sparc/Kconfig"
osource "/home/rowan/zephyrproject/zephyr/arch/riscv/Kconfig"
osource "/home/rowan/zephyrproject/zephyr/arch/posix/Kconfig"
osource "/home/rowan/zephyrproject/zephyr/arch/nios2/Kconfig"
osource "/home/rowan/zephyrproject/zephyr/arch/mips/Kconfig"
osource "/home/rowan/zephyrproject/zephyr/arch/arm64/Kconfig"
osource "/home/rowan/zephyrproject/zephyr/arch/arm/Kconfig"
osource "/home/rowan/zephyrproject/zephyr/arch/arc/Kconfig"
```

## zephyr-projects/arm_firmware_teensy41/build/Kconfig/boards/Kconfig
```kconfig
# Load Zephyr board Kconfig descriptions.
osource "/home/rowan/zephyrproject/zephyr/boards/pjrc/teensy4/Kconfig"
```

## zephyr-projects/arm_firmware_teensy41/build/Kconfig/boards/Kconfig.defconfig
```kconfig
# Load Zephyr board defconfig descriptions.
osource "/home/rowan/zephyrproject/zephyr/boards/pjrc/teensy4/Kconfig.defconfig"
```

## zephyr-projects/arm_firmware_teensy41/build/Kconfig/boards/Kconfig.teensy41
```kconfig
# Load board Kconfig descriptions.
osource "/home/rowan/zephyrproject/zephyr/boards/pjrc/teensy4/Kconfig.teensy41"
```

## zephyr-projects/esp_cbs/build/Kconfig/boards/Kconfig
```kconfig
# Load Zephyr board Kconfig descriptions.
osource "/home/rowan/zephyrproject/zephyr/boards/espressif/esp32_devkitc_wrover/Kconfig"
```

## zephyr-projects/esp_cbs/build/Kconfig/boards/Kconfig.defconfig
```kconfig
# Load Zephyr board defconfig descriptions.
osource "/home/rowan/zephyrproject/zephyr/boards/espressif/esp32_devkitc_wrover/Kconfig.defconfig"
```

## zephyr-projects/esp_cbs/build/Kconfig/boards/Kconfig.esp32_devkitc_wrover
```kconfig
# Load board Kconfig descriptions.
osource "/home/rowan/zephyrproject/zephyr/boards/espressif/esp32_devkitc_wrover/Kconfig.esp32_devkitc_wrover"
```
